## boards/arm/dice_poker/Kconfig.board
```kconfig
# Copyright (c) 2021 Nick Winans
# SPDX-License-Identifier: MIT

config BOARD_DICE_POKER
    bool "dice_poker"
    depends on SOC_NRF52840_QIAA
```

## boards/arm/dice_poker/Kconfig.defconfig
```kconfig
# Copyright (c) 2021 Nick Winans
# SPDX-License-Identifier: MIT

if BOARD_DICE_POKER

config ZMK_KEYBOARD_NAME
    default "dice_poker"

if USB_DEVICE_STACK

config USB_NRFX
    default y

endif # USB_DEVICE_STACK

config BT_CTLR
    default BT

config ZMK_BLE
    default y

config ZMK_USB
    default y

endif # BOARD_DICE_POKER
```
